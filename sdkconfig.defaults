## sdkconfig.defaults
```kconfig
CONFIG_FREERTOS_HZ=1000

# Wi-Fi Provisioning
CONFIG_WIFI_PROV_SCHEME_BLE=y

# Bluetooth (Bluedroid )
CONFIG_BT_ENABLED=y
CONFIG_BT_BLUEDROID_ENABLED=y
CONFIG_BT_NIMBLE_ENABLED=n
CONFIG_BT_CLASSIC_ENABLED=n
CONFIG_BT_BLE_ENABLED=y

# Disable NimBLE
CONFIG_BT_NIMBLE_ENABLED=n
```
